## configs/RMDevBoard/userled/defconfig
```kconfig
# CONFIG_ARCH_BUTTONS is not set
# CONFIG_ARCH_FPU is not set
# CONFIG_ARCH_LEDS is not set
# CONFIG_NSH_DISABLE_IFCONFIG is not set
# CONFIG_NSH_DISABLE_PS is not set
# CONFIG_STM32_FLASH_PREFETCH is not set
CONFIG_ARCH_BOARD_RMDEVBOARD=y
CONFIG_ARCH_BOARD="RMDevBoard"
CONFIG_ARCH_CHIP_STM32=y
CONFIG_ARCH_CHIP_STM32F427I=y
CONFIG_ARCH_STACKDUMP=y
CONFIG_ARCH="arm"
CONFIG_BOARD_INITIALIZE=y
CONFIG_BOARD_LOOPSPERMSEC=16717
CONFIG_BUILTIN=y
CONFIG_DEBUG_FULLOPT=y
CONFIG_DEBUG_SYMBOLS=y
# CONFIG_DISABLE_POLL=y
# CONFIG_EXAMPLES_NSH_CXXINITIALIZE=y
CONFIG_EXAMPLES_LEDC=y
CONFIG_EXAMPLES_LEDS=y
CONFIG_EXAMPLES_NSH=y
CONFIG_FS_PROCFS=y
CONFIG_FS_PROCFS_REGISTER=y
CONFIG_HAVE_CXX=y
CONFIG_HAVE_CXXINITIALIZE=y
# CONFIG_INTELHEX_BINARY=y
CONFIG_LIBC_STRERROR=y
CONFIG_MAX_TASKS=16
CONFIG_MAX_WDOGPARMS=2
CONFIG_MM_REGIONS=1
CONFIG_NFILE_DESCRIPTORS=8
CONFIG_NFILE_STREAMS=8
CONFIG_NSH_BUILTIN_APPS=y
CONFIG_NSH_FILEIOSIZE=512
CONFIG_NSH_LINELEN=64
CONFIG_NSH_READLINE=y
CONFIG_PREALLOC_MQ_MSGS=4
CONFIG_PREALLOC_TIMERS=4
CONFIG_PREALLOC_WDOGS=4
CONFIG_RAM_SIZE=262144
CONFIG_RAM_START=0x20000000
CONFIG_RAW_BINARY=y
CONFIG_RR_INTERVAL=200
CONFIG_SCHED_WAITPID=y
CONFIG_SDCLONE_DISABLE=y
CONFIG_SERIAL_TERMIOS=y
CONFIG_START_DAY=18
CONFIG_START_MONTH=2
CONFIG_START_YEAR=2018
CONFIG_STM32_CCMEXCLUDE=y
CONFIG_STM32_DISABLE_IDLE_SLEEP_DURING_DEBUG=y
CONFIG_STM32_JTAG_SW_ENABLE=y
CONFIG_STM32_PWR=y
CONFIG_STM32_USART3=y
CONFIG_TASK_NAME_SIZE=24
CONFIG_USART3_SERIAL_CONSOLE=y
CONFIG_USER_ENTRYPOINT="nsh_main"
CONFIG_USERLED_LOWER=y
CONFIG_USERLED=y
CONFIG_WDOG_INTRESERVE=0
```

## configs/fire-stm32v2/Kconfig
```kconfig
#
# For a description of the syntax of this configuration file,
# see the file kconfig-language.txt in the NuttX tools repository.
#

comment "M3 Wildfire Configuration"

if ARCH_BOARD_FIRE_STM32

config FIRE_STM32_FLASH
	bool "MTD driver for external 8Mbyte W25Q64 FLASH on SPI1"
	default n
	select MTD
	select MTD_W25
	select MTD_SMART
	select FS_SMARTFS
	select STM32_SPI1
	select MTD_BYTE_WRITE
	---help---
		Configures an MTD device for use with the onboard flash

config FIRE_STM32_FLASH_MINOR
	int "Minor number for the FLASH /dev/smart entry"
	default 0
	depends on FIRE_STM32_FLASH
	---help---
		Sets the minor number for the FLASH MTD /dev entry

config FIRE_STM32_FLASH_PART
	bool "Enable partition support on FLASH"
	default y
	depends on FIRE_STM32_FLASH
	select MTD_PARTITION
	---help---
		Enables creation of partitions on the FLASH

config FIRE_STM32_FLASH_CONFIG_PART
	bool "Create application config data partition on FLASH"
	default n
	depends on FIRE_STM32_FLASH_PART
	depends on PLATFORM_CONFIGDATA
	---help---
		Enables creation of a /dev/config partition on the FLASH

config FIRE_STM32_FLASH_CONFIG_PART_NUMBER
	int "Index number of config partition (in list below)"
	default 0
	depends on FIRE_STM32_FLASH_CONFIG_PART
	---help---
		Specifies the index number of the config data partition
		from the partition list.

config FIRE_STM32_FLASH_PART_LIST
	string "Flash partition size list"
	default "1024,1024,1024,1024,1024,1024,1024,1024"
	depends on FIRE_STM32_FLASH_PART
	---help---
		Comma separated list of partition sizes in KB.

config FIRE_STM32_FLASH_PART_NAMES
	string "Flash partition name list"
	default "first,second,third,forth"
	depends on FIRE_STM32_FLASH_PART
	depends on MTD_PARTITION_NAMES
	---help---
		Comma separated list of partition names.

choice
	prompt "Select Wildfire STM32 version"
	default ARCH_BOARD_FIRE_STM32V2
	---help---
		This port has logic differences to support either the Version 2 or
		Version 3 of the Wildfire board.

config ARCH_BOARD_FIRE_STM32V2
	bool "Wildfire STM32v2"
	---help---
		Selects the M3 Wildfire version 2.

config ARCH_BOARD_FIRE_STM32V3
	bool "Wildfire STM32v3"
	---help---
		Selects the M3 Wildfire version 3.

endchoice
endif
```

## configs/fire-stm32v2/base/defconfig
```kconfig
# CONFIG_MMCSD_HAVE_CARDDETECT is not set
# CONFIG_MMCSD_MMCSUPPORT is not set
# CONFIG_NSH_DISABLE_IFCONFIG is not set
# CONFIG_NSH_DISABLE_PS is not set
# CONFIG_SPI_CALLBACK is not set
# CONFIG_ARCH_LEDS is not set
# CONFIG_USERLED is not set
CONFIG_ARCH_BOARD_FIRE_STM32=y
CONFIG_ARCH_BOARD_FIRE_STM32V3=y
CONFIG_ARCH_BOARD="fire-stm32v2"
CONFIG_ARCH_BUTTONS=y
CONFIG_ARCH_IRQBUTTONS=y
CONFIG_ARCH_CHIP_STM32=y
CONFIG_ARCH_CHIP_STM32F103VE=y
CONFIG_ARCH_STACKDUMP=y
CONFIG_ARCH="arm"
CONFIG_ARMV7M_TOOLCHAIN_CODESOURCERYW=y
CONFIG_BOARD_LOOPSPERMSEC=5483
CONFIG_BUILTIN=y
CONFIG_INPUT=y
CONFIG_BUTTONS=y
CONFIG_BUTTONS_LOWER=y
CONFIG_BUTTONS_NPOLLWAITERS=2
CONFIG_CL_MFRC522=y
CONFIG_MFRC522_SPI_FREQ=1000000
CONFIG_DEBUG_SYMBOLS=y
CONFIG_DRIVERS_CONTACTLESS=y
CONFIG_DEV_GPIO=y
CONFIG_EXAMPLES_NSH=y
CONFIG_EXAMPLES_BUTTONS=y
CONFIG_EXAMPLES_BUTTONS_PRIORITY=100
CONFIG_EXAMPLES_BUTTONS_STACKSIZE=2048
CONFIG_EXAMPLES_BUTTONS_DEVPATH="/dev/buttons"
CONFIG_EXAMPLES_GPIO=y
CONFIG_EXAMPLES_GPIO_PRIORITY=100
CONFIG_EXAMPLES_GPIO_STACKSIZE=2048
CONFIG_EXAMPLES_RFID_READUID=y
CONFIG_EXAMPLES_RFID_READUID_PRIORITY=100
CONFIG_EXAMPLES_RFID_READUID_STACKSIZE=2048
CONFIG_EXAMPLES_RGBLED=y
CONFIG_EXAMPLES_RGBLED_DEVNAME="/dev/rgbled0"
CONFIG_EXAMPLES_RGBLED_PRIORITY=100
CONFIG_EXAMPLES_RGBLED_STACKSIZE=2048
CONFIG_I2C_POLLED=y
CONFIG_I2C=y
CONFIG_INTELHEX_BINARY=y
CONFIG_MAX_TASKS=16
CONFIG_MAX_WDOGPARMS=2
CONFIG_NETUTILS_ESP8266=y
CONFIG_NETUTILS_ESP8266_DEV_PATH="/dev/ttyS1"
CONFIG_NETUTILS_ESP8266_BAUDRATE=115200
CONFIG_NETUTILS_ESP8266_MAXTXLEN=256
CONFIG_NETUTILS_ESP8266_MAXRXLEN=256
CONFIG_NETUTILS_ESP8266_WORKER_BUF_LEN=256
CONFIG_NETUTILS_ESP8266_THREADPRIO=100
CONFIG_NFILE_DESCRIPTORS=8
CONFIG_NFILE_STREAMS=8
CONFIG_NSH_ARCHINIT=y
CONFIG_NSH_BUILTIN_APPS=y
CONFIG_NSH_FILEIOSIZE=512
CONFIG_NSH_LINELEN=64
CONFIG_NSH_NOMAC=y
CONFIG_NSH_READLINE=y
CONFIG_NSOCKET_DESCRIPTORS=16
CONFIG_PREALLOC_MQ_MSGS=4
CONFIG_PREALLOC_WDOGS=16
CONFIG_PWM=y
CONFIG_PWM_MULTICHAN=y
CONFIG_PWM_NCHANNELS=3
CONFIG_RAM_SIZE=65536
CONFIG_RAM_START=0x20000000
CONFIG_RR_INTERVAL=200
CONFIG_RTC=y
CONFIG_SCHED_HPWORK=y
CONFIG_SCHED_HPWORKPRIORITY=192
CONFIG_SCHED_HPWORKSTACKSIZE=1024
CONFIG_SCHED_WAITPID=y
CONFIG_SLCD=y
CONFIG_LCD_BACKPACK=y
CONFIG_RGBLED=y
CONFIG_STM32_BKP=y
CONFIG_STM32_DMA2=y
CONFIG_STM32_I2C1=y
CONFIG_STM32_JTAG_SW_ENABLE=y
CONFIG_STM32_PWR=y
CONFIG_STM32_SPI1=y
CONFIG_STM32_TIM3=y
CONFIG_STM32_TIM3_PARTIAL_REMAP=y
CONFIG_STM32_TIM3_PWM=y
CONFIG_STM32_TIM3_MODE=0
CONFIG_STM32_TIM3_CHANNEL2=y
CONFIG_STM32_TIM3_CH2MODE=0
CONFIG_STM32_TIM3_CH2OUT=y
CONFIG_STM32_TIM3_CHANNEL3=y
CONFIG_STM32_TIM3_CH3MODE=0
CONFIG_STM32_TIM3_CH3OUT=y
CONFIG_STM32_TIM3_CHANNEL4=y
CONFIG_STM32_TIM3_CH4MODE=0
CONFIG_STM32_TIM3_CH4OUT=y
CONFIG_STM32_PWM_MULTICHAN=y
CONFIG_STM32_USART1=y
CONFIG_STM32_USART2=y
CONFIG_SYSTEM_PING=y
CONFIG_TASK_NAME_SIZE=0
CONFIG_USART1_SERIAL_CONSOLE=y
CONFIG_USER_ENTRYPOINT="nsh_main"
CONFIG_WDOG_INTRESERVE=2
```

## configs/fire-stm32v2/userled/defconfig
```kconfig
# CONFIG_ARCH_LEDS is not set
# CONFIG_MMCSD_HAVE_CARDDETECT is not set
# CONFIG_MMCSD_MMCSUPPORT is not set
# CONFIG_NSH_DISABLE_IFCONFIG is not set
# CONFIG_NSH_DISABLE_PS is not set
# CONFIG_SPI_CALLBACK is not set
CONFIG_ARCH_BOARD_FIRE_STM32=y
CONFIG_ARCH_BOARD_FIRE_STM32V3=y
CONFIG_ARCH_BOARD="fire-stm32v2"
CONFIG_ARCH_CHIP_STM32=y
CONFIG_ARCH_CHIP_STM32F103VE=y
CONFIG_ARCH_STACKDUMP=y
CONFIG_ARCH="arm"
CONFIG_ARMV7M_TOOLCHAIN_CODESOURCERYW=y
CONFIG_BOARD_LOOPSPERMSEC=5483
CONFIG_BUILTIN=y
# CONFIG_EXAMPLES_LEDS=y
CONFIG_EXAMPLES_LEDC=y
CONFIG_EXAMPLES_NSH=y
CONFIG_MAX_TASKS=16
CONFIG_MAX_WDOGPARMS=2
CONFIG_NFILE_DESCRIPTORS=8
CONFIG_NFILE_STREAMS=8
CONFIG_NSH_ARCHINIT=y
CONFIG_NSH_BUILTIN_APPS=y
CONFIG_NSH_FILEIOSIZE=1024
CONFIG_NSH_LINELEN=80
CONFIG_PREALLOC_MQ_MSGS=4
CONFIG_PREALLOC_TIMERS=4
CONFIG_PREALLOC_WDOGS=4
CONFIG_RAM_SIZE=65536
CONFIG_RAM_START=0x20000000
CONFIG_RAW_BINARY=y
CONFIG_RR_INTERVAL=200
CONFIG_SCHED_HPWORK=y
CONFIG_SCHED_HPWORKPRIORITY=192
CONFIG_SCHED_WAITPID=y
CONFIG_SDCLONE_DISABLE=y
CONFIG_SERIAL_TERMIOS=y
CONFIG_START_DAY=5
CONFIG_START_MONTH=7
CONFIG_START_YEAR=2011
CONFIG_STM32_DISABLE_IDLE_SLEEP_DURING_DEBUG=y
CONFIG_STM32_JTAG_SW_ENABLE=y
CONFIG_STM32_USART1=y
CONFIG_STM32_I2C1=y
CONFIG_SYMTAB_ORDEREDBYNAME=y
CONFIG_TASK_NAME_SIZE=0
CONFIG_USART1_SERIAL_CONSOLE=y
CONFIG_USER_ENTRYPOINT="nsh_main"
CONFIG_USERLED_LOWER=y
CONFIG_USERLED=y
CONFIG_WDOG_INTRESERVE=0
```
